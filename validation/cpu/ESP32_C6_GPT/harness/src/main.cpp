/* Hardware test harness: microgpt_int INFERENCE on the target MCU.
 *
 * The .mgw weight image trained on the host lives in flash (model_mgw.h,
 * generated by prepare.sh) and is loaded zero-copy via mgpt_load_mem() —
 * the MCU reads the Q16.48 weights in place from memory-mapped flash, they never
 * occupy RAM. Each loop iteration re-loads the image (which resets the
 * PRNG to the state saved at training time), generates the same 20 samples
 * the host's training run printed, hashes them, and prints a structured
 * result record; PASS means byte-identical names on the target.
 *
 * build_info.h (repo commit stamp), model_mgw.h (weights), and gpt_pin.h
 * (expected hash from a HOST run of the same entry points at prepare time)
 * are all generated by prepare.sh — this file hardcodes none of them.
 *
 * Hash definition (must match hostref/host_main.c): FNV-1a 64 over each
 * sample's characters followed by one '\n', samples in order.
 */
#include <Arduino.h>
#include <stdint.h>
#include <stddef.h>
#include "build_info.h"
#include "gpt_pin.h"
#include "model_mgw.h"

#ifndef HW_TEST_TARGET
#error "HW_TEST_TARGET must be defined in platformio.ini build_flags"
#endif

#if defined(__riscv)
#define HW_ARCH "rv32"
#elif defined(__arm__) || defined(__ARM_ARCH)
#define HW_ARCH "arm"
#else
#define HW_ARCH "unknown"
#endif

extern "C" int mgpt_load_mem(const void *buf, size_t len);
extern "C" int mgpt_generate_sample(char *out);

#define FNV64_OFFSET 1469598103934665603ULL
#define FNV64_PRIME  1099511628211ULL

static uint64_t fnv_sample(uint64_t h, const char *s)
{
    for (; *s; s++) { h ^= (uint64_t)(unsigned char)*s; h *= FNV64_PRIME; }
    h ^= (uint64_t)'\n'; h *= FNV64_PRIME;
    return h;
}

static void print_hex64(uint64_t v)
{
    char buf[17];
    for (int i = 15; i >= 0; i--) { buf[i] = "0123456789abcdef"[v & 0xf]; v >>= 4; }
    buf[16] = 0;
    Serial.print(buf);
}

void setup()
{
    Serial.begin(115200);
}

void loop()
{
    uint32_t t0 = millis();
    if (mgpt_load_mem(model_mgw, model_mgw_len) != 0) {
        Serial.println("profile: FAIL - mgpt_load_mem rejected the flash image");
        delay(3000);
        return;
    }
    uint64_t h = FNV64_OFFSET;
    char sample[16];
    for (int i = 0; i < 20; i++) {
        mgpt_generate_sample(sample);
        Serial.print("sample ");
        if (i + 1 < 10) Serial.print(' ');
        Serial.print(i + 1);
        Serial.print(": ");
        Serial.println(sample);
        h = fnv_sample(h, sample);
    }
    uint32_t dt = millis() - t0;

    Serial.print("target " HW_TEST_TARGET " arch " HW_ARCH
                 " tree " BUILD_COMMIT " PROFILE microgpt hash ");
    print_hex64(h);
    Serial.print(" (");
    Serial.print(dt);
    Serial.println(" ms, informational)");
    if (h == PINNED_HASH) {
        Serial.println("profile: PASS (target reproduces the host sample stream)");
    } else {
        Serial.print("profile: FAIL - expected ");
        print_hex64(PINNED_HASH);
        Serial.println("");
    }
    delay(3000);
}
