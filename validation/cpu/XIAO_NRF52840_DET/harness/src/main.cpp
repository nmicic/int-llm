/* Hardware test harness for int-llm's fp_math.h
 * determinism gate. Runs fp_det_compute() (the same grid + FNV-1a hashing
 * as `make determinism`, compiled with the portable two-limb backend on
 * this MCU) and prints a structured result record over serial,
 * repeating so a late attach still sees it.
 *
 * build_info.h (repo commit stamp) and det_pin.h (expected hash, computed
 * by a HOST run against tests/determinism_golden.txt at prepare time) are
 * both generated by prepare.sh — this file hardcodes neither.
 */
#include <Arduino.h>
#ifdef USE_TINYUSB
#include <Adafruit_TinyUSB.h>   /* Adafruit nRF52 core: USB CDC lives here */
#endif
#include <stdint.h>
#include "build_info.h"
#include "det_pin.h"

#ifndef HW_TEST_TARGET
#error "HW_TEST_TARGET must be defined in platformio.ini build_flags"
#endif

#if defined(__riscv)
#define HW_ARCH "rv32"
#elif defined(__arm__) || defined(__ARM_ARCH)
#define HW_ARCH "arm"
#else
#define HW_ARCH "unknown"
#endif

#define FP_DET_NUM_SUBS 12
extern "C" uint64_t fp_det_compute(uint64_t subs_out[FP_DET_NUM_SUBS]);

static void print_hex64(uint64_t v)
{
    char buf[17];
    for (int i = 15; i >= 0; i--) { buf[i] = "0123456789abcdef"[v & 0xf]; v >>= 4; }
    buf[16] = 0;
    Serial.print(buf);
}

void setup()
{
    Serial.begin(115200);
}

void loop()
{
    uint32_t t0 = millis();
    uint64_t subs[FP_DET_NUM_SUBS];
    uint64_t h = fp_det_compute(subs);
    uint32_t dt = millis() - t0;

    Serial.print("target " HW_TEST_TARGET " arch " HW_ARCH
                 " tree " BUILD_COMMIT " PROFILE det hash ");
    print_hex64(h);
    Serial.print(" (");
    Serial.print(dt);
    Serial.println(" ms, informational)");
    if (h == PINNED_HASH) {
        Serial.println("profile: PASS (target reproduces the host determinism hash)");
    } else {
        Serial.print("profile: FAIL - expected ");
        print_hex64(PINNED_HASH);
        Serial.println("");
        for (int i = 0; i < FP_DET_NUM_SUBS; i++) {
            Serial.print("sub[");
            Serial.print(i);
            Serial.print("] ");
            print_hex64(subs[i]);
            Serial.println("");
        }
    }
    delay(3000);
}
